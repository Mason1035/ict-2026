## firmware/node01/components/node_comm/Kconfig
```kconfig
menu "NODE-01 communication"
config NODE01_NETWORK_ENABLE
    bool "Enable provisioned Wi-Fi/MQTT (hardware/Broker NOT_RUN)"
    default n
    help
        Reads credentials from device NVS, never from committed sdkconfig.
        Requires node01_net strings: ssid, psk, uri, user, pass, site.
        Requires a reviewed, provisioned node01_id/last_boot u64 counter.
        Missing/corrupt state blocks publishing. No automatic NVS erase or ID seeding.

config NODE01_WIFI_ONLY
    bool "Include a disarmed Wi-Fi-only diagnostic"
    depends on !NODE01_NETWORK_ENABLE && !NODE01_MQTT_ONLY
    default n
    help
        STA only. Also requires read-only NVS node01_net/wifi_only (u8)
        set explicitly to 1 and valid ssid/psk. Without that flag the
        firmware does not initialize the radio. No MQTT or telemetry ID.

config NODE01_MQTT_ONLY
    bool "Include disarmed MQTT transport-only diagnostic"
    depends on !NODE01_NETWORK_ENABLE
    depends on MQTT_PROTOCOL_311
    default n
    help
        Reads only node01_mqdiag NVS. enable=1 is required before radio init.
        Wi-Fi STA then MQTT CONNECT only. No telemetry identity, subscriptions,
        publishes, or last will. Uses a separate diagnostic MQTT client ID.
config NODE01_REAL_TEST_ONLY
    bool "Include disarmed REAL Telemetry v2 TEST_ONLY publisher"
    depends on NODE01_MQTT_ONLY && NODE01_TOE_BENCH_QUEUE_SD && !MQTT_TRANSPORT_SSL
    default n
    help
        An armed NVS profile starts isolated lab TCP in CONNECT-only mode.
        Publishing also requires explicit UART authorization, receiver approval,
        and one external identity reservation. No automatic identity allocation.
endmenu
```

## firmware/node01/components/node_runtime/Kconfig
```kconfig
menu "NODE-01 acquisition/storage diagnostics"
choice NODE01_DIAGNOSTIC_MODE
    prompt "Diagnostic isolation (never a calibrated experiment)"
    default NODE01_DIAG_ACQUISITION
config NODE01_DIAG_ACQUISITION
    bool "Real sensors with diagnostic SD recording"
config NODE01_DIAG_SENSORS_ONLY
    bool "TEST_ONLY: real I2C sensors, no SD or network"
    select I2C_ENABLE_DEBUG_LOG
    help
        Include SDK I2C NACK diagnostics that INFO builds cannot expose.
        Extra error logging changes timing; this is an isolation test.
config NODE01_DIAG_TOE_BENCH
    bool "TEST_ONLY: finite dual-IMU TOE bench, no SD or formal protocol"
    depends on !NODE01_NETWORK_ENABLE
    select NODE01_IMU_DRDY
config NODE01_DIAG_STORAGE_ONLY
    bool "SYNTHETIC/TEST_ONLY: SD load, no I2C or network"
endchoice

config NODE01_TOE_BENCH_ADS
    bool "TEST_ONLY: add ADS1115 load to dual-IMU bench"
    depends on NODE01_DIAG_TOE_BENCH

config NODE01_TOE_BENCH_SD
    bool "TEST_ONLY: add finite MicroSD I/O without production Queue"
    depends on NODE01_TOE_BENCH_ADS

config NODE01_TOE_BENCH_QUEUE_SD
    bool "TEST_ONLY: use production Queue and CSV Writer instead of synthetic SD I/O"
    depends on NODE01_TOE_BENCH_SD
choice NODE01_STARTUP_PLAN
    prompt "TEST_ONLY controlled integration startup experiment"
    depends on NODE01_DIAG_ACQUISITION
    default NODE01_STARTUP_CONCURRENT
config NODE01_STARTUP_CONCURRENT
    bool "Concurrent startup (original task dependency order)"
config NODE01_STARTUP_PROBE
    bool "A: concurrent startup plus three fixed I2C address probes"
    help
        Same address-only SDK probes as Sensors-only, before task creation.
        Does not enable I2C DEBUG, retry, or change sensor registers.
config NODE01_STARTUP_IMU_FIRST
    bool "B: IMUs ready, then ADS ready, then SD mount/open, then capture"
    help
        TEST_ONLY dependency experiment. Failed prerequisites block capture.
        Task priorities, I2C speed, ODR and the storage service stay unchanged.
endchoice
config NODE01_IMU_DRDY
    bool "Service 100Hz IMU updates from frozen GPIO4/5 DRDY (hardware retest required)"
    default n
    help
        Keeps the sensor ODR at 100Hz. The ISR only counts/notifies; task
        context validates Data Ready and reads the real observation.
        Missing IRQs use an explicitly counted polling fallback.
config NODE01_CAPTURE_SECONDS
    int "Controlled diagnostic capture duration (0 = continuous)"
    range 0 3600
    default 0
    help
        Nonzero: stop producers at the actual monotonic deadline, drain the
        queue, close the single capture file, then fully verify it.
        Periodic fsync remains. This does not guarantee zero loss/durability.
config NODE01_SANDBOX_EXPERIMENT
    bool "Operator-controlled sandbox capture (30-300 seconds, one run per boot)"
    depends on NODE01_DIAG_ACQUISITION && NODE01_STARTUP_IMU_FIRST && NODE01_IMU_DRDY && !NODE01_NETWORK_ENABLE && !NODE01_WIFI_ONLY && !NODE01_MQTT_ONLY
    default n
    help
        Separate candidate mode. Initializes real sensors and SD, waits for
        EXP START seconds on UART0 or USB Serial/JTAG secondary, accepts STOP.
        No automatic experiment, calibration or risk. Hardware input not verified.
config NODE01_I2C_LOCK_DIAG_TRACE
    bool "TEST_ONLY: finite RAM I2C mutex lifecycle trace (post-capture output)"
    depends on NODE01_SANDBOX_EXPERIMENT
    default n
    help
        Independent diagnostic candidate only. Records first 100ms and first
        eight ADS channel attempts, bounded rolling history and anomalies.
        No timeout/priority/ODR change. Intrusion needs real-board assessment.
        Saturation or missing links explicitly prevents completeness claims.
config NODE01_TOE_STATUS_TRACE
    bool "TEST_ONLY: bounded TOE INT1 and existing INT_STATUS trace"
    depends on NODE01_SANDBOX_EXPERIMENT && !NODE01_I2C_LOCK_DIAG_TRACE
    default n
    help
        Observe existing rising IRQs and TOE INT_STATUS transactions.
        No extra I2C reads, retries, GPIO transitions, or IRQ reconfiguration.
        Export records in HealthTask after the capture has finished.
endmenu
```
