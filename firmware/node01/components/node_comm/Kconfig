## firmware/node01/components/node_comm/Kconfig
```kconfig
menu "NODE-01 communication"
config NODE01_NETWORK_ENABLE
    bool "Enable provisioned Wi-Fi/MQTT (hardware/Broker NOT_RUN)"
    default n
    help
        Reads credentials from device NVS, never from committed sdkconfig.
        Requires node01_net strings: ssid, psk, uri, user, pass, site.
        Requires a reviewed, provisioned node01_id/last_boot u64 counter.
        Missing/corrupt state blocks publishing. No automatic NVS erase or ID seeding.
endmenu
```

## firmware/node01/components/node_drivers/Kconfig
```kconfig
menu "NODE-01 V0.1 bring-up"
config NODE01_I2C_HZ
    int "I2C clock Hz (diagnostic 100000; formal target 400000)"
    range 100000 400000
    default 100000
    help
        Arduino 100 kHz evidence does not validate this ESP-IDF driver.
        400 kHz requires a separate hardware test.
config NODE01_SD_KHZ
    int "SD SPI clock kHz (diagnostic 1000; formal 20000 or 10000)"
    range 1000 20000
    default 1000
endmenu
```

## firmware/node01/components/node_runtime/Kconfig
```kconfig
menu "NODE-01 acquisition/storage diagnostics"
choice NODE01_DIAGNOSTIC_MODE
    prompt "Diagnostic isolation (never a calibrated experiment)"
    default NODE01_DIAG_ACQUISITION
config NODE01_DIAG_ACQUISITION
    bool "Real sensors with diagnostic SD recording"
config NODE01_DIAG_SENSORS_ONLY
    bool "TEST_ONLY: real I2C sensors, no SD or network"
    select I2C_ENABLE_DEBUG_LOG
    help
        Include SDK I2C NACK diagnostics that INFO builds cannot expose.
        Extra error logging changes timing; this is an isolation test.
config NODE01_DIAG_STORAGE_ONLY
    bool "SYNTHETIC/TEST_ONLY: SD load, no I2C or network"
endchoice
choice NODE01_STARTUP_PLAN
    prompt "TEST_ONLY controlled integration startup experiment"
    depends on NODE01_DIAG_ACQUISITION
    default NODE01_STARTUP_CONCURRENT
config NODE01_STARTUP_CONCURRENT
    bool "Concurrent startup (original task dependency order)"
config NODE01_STARTUP_PROBE
    bool "A: concurrent startup plus three fixed I2C address probes"
    help
        Same address-only SDK probes as Sensors-only, before task creation.
        Does not enable I2C DEBUG, retry, or change sensor registers.
config NODE01_STARTUP_IMU_FIRST
    bool "B: IMUs ready, then ADS ready, then SD mount/open, then capture"
    help
        TEST_ONLY dependency experiment. Failed prerequisites block capture.
        Task priorities, I2C speed, ODR and the storage service stay unchanged.
endchoice
config NODE01_IMU_DRDY
    bool "Service 100Hz IMU updates from frozen GPIO4/5 DRDY (hardware retest required)"
    default n
    help
        Keeps the sensor ODR at 100Hz. The ISR only counts/notifies; task
        context validates Data Ready and reads the real observation.
        Missing IRQs use an explicitly counted polling fallback.
config NODE01_CAPTURE_SECONDS
    int "Controlled diagnostic capture duration (0 = continuous)"
    range 0 3600
    default 0
    help
        Nonzero: stop producers at the actual monotonic deadline, drain the
        queue, close the single capture file, then fully verify it.
        Periodic fsync remains. This does not guarantee zero loss/durability.
config NODE01_SANDBOX_EXPERIMENT
    bool "Operator-controlled sandbox capture (30-300 seconds, one run per boot)"
    depends on NODE01_DIAG_ACQUISITION && NODE01_STARTUP_IMU_FIRST && NODE01_IMU_DRDY && !NODE01_NETWORK_ENABLE
    default n
    help
        Separate candidate mode. Initializes real sensors and SD, waits for
        EXP START seconds on UART0 or USB Serial/JTAG secondary, accepts STOP.
        No automatic experiment, calibration or risk. Hardware input not verified.
config NODE01_I2C_LOCK_DIAG_TRACE
    bool "TEST_ONLY: finite RAM I2C mutex lifecycle trace (post-capture output)"
    depends on NODE01_SANDBOX_EXPERIMENT
    default n
    help
        Independent diagnostic candidate only. Records first 100ms and first
        eight ADS channel attempts, bounded rolling history and anomalies.
        No timeout/priority/ODR change. Intrusion needs real-board assessment.
        Saturation or missing links explicitly prevents completeness claims.
endmenu
```

## firmware/node01/sdkconfig.defaults
```kconfig
CONFIG_IDF_TARGET="esp32s3"
CONFIG_ESPTOOLPY_FLASHSIZE_8MB=y
CONFIG_ESPTOOLPY_FLASHMODE_QIO=y
CONFIG_ESPTOOLPY_FLASHFREQ_80M=y
CONFIG_SPIRAM=y
CONFIG_SPIRAM_MODE_OCT=y
CONFIG_SPIRAM_SPEED_80M=y
CONFIG_SPIRAM_BOOT_INIT=y
CONFIG_SPIRAM_MEMTEST=y
# CONFIG_SPIRAM_IGNORE_NOTFOUND is not set
CONFIG_ESP_CONSOLE_UART_DEFAULT=y
CONFIG_ESP_CONSOLE_UART_BAUDRATE=115200
```

## firmware/tinyquake_esp32s3/main/Kconfig.projbuild
```kconfig
menu "TinyQuake experimental reference runner"
config TINYQUAKE_ARENA_BYTES
    int "Initial arena capacity (not a measured requirement)"
    range 32768 262144
    default 131072
config TINYQUAKE_MQTT_ENABLE
    bool "Publish REFERENCE results over Wi-Fi/MQTT"
    default n
config TINYQUAKE_WIFI_SSID
    string "Wi-Fi SSID"
    default ""
    depends on TINYQUAKE_MQTT_ENABLE
config TINYQUAKE_WIFI_PASSWORD
    string "Wi-Fi password (do not commit sdkconfig)"
    default ""
    depends on TINYQUAKE_MQTT_ENABLE
config TINYQUAKE_BROKER_URI
    string "LAN MQTT Broker URI"
    default "mqtt://192.168.1.100:1883"
    depends on TINYQUAKE_MQTT_ENABLE
config TINYQUAKE_MQTT_USERNAME
    string "MQTT username"
    default ""
    depends on TINYQUAKE_MQTT_ENABLE
config TINYQUAKE_MQTT_PASSWORD
    string "MQTT password (do not commit sdkconfig)"
    default ""
    depends on TINYQUAKE_MQTT_ENABLE
config TINYQUAKE_SITE_ID
    string "Site ID (letters, digits, hyphen, underscore)"
    default "TQ-LAB"
config TINYQUAKE_DEVICE_ID
    string "Isolated experimental device ID"
    default "ESP32-TQ-01"
endmenu
```

## firmware/tinyquake_esp32s3/sdkconfig.defaults
```kconfig
CONFIG_IDF_TARGET="esp32s3"
CONFIG_ESPTOOLPY_FLASHSIZE_8MB=y
CONFIG_PARTITION_TABLE_SINGLE_APP_LARGE=y
CONFIG_ESP_CONSOLE_USB_SERIAL_JTAG=y
CONFIG_ESP_MAIN_TASK_STACK_SIZE=16384
CONFIG_SPIRAM=y
CONFIG_SPIRAM_MODE_OCT=y
CONFIG_SPIRAM_SPEED_80M=y
CONFIG_FREERTOS_HZ=1000
```
